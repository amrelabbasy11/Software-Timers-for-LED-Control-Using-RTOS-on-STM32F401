# file: Software_Timer_RTOS.ioc
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FREERTOS.Tasks01=Task_One,24,128,TaskOne,Default,NULL,Dynamic,NULL,NULL
FREERTOS.Timers01=Timer_One,MyTimerOne_Callback,osTimerPeriodic,Default,NULL,Dynamic,NULL;Timer_Two,MyTimerTwo_Callback,osTimerOnce,Default,NULL,Dynamic,NULL
Mcu.Family=STM32F4
Mcu.Name=STM32F401R(B-C)Tx
Mcu.Package=LQFP64
NVIC.PriorityGroup=NVIC_PRIORITYGROUP_4
NVIC.TIM4_IRQn=true\:15\:0\:false\:false\:true\:false\:false\:true
NVIC.TimeBase=TIM4_IRQn
NVIC.TimeBaseIP=TIM4
PH0\ -\ OSC_IN.Mode=HSE-External-Clock-Source
PH0\ -\ OSC_IN.Signal=RCC_OSC_IN
PH1\ -\ OSC_OUT.Mode=HSE-External-Clock-Source
PH1\ -\ OSC_OUT.Signal=RCC_OSC_OUT
ProjectManager.HeapSize=0x200
ProjectManager.StackSize=0x400
ProjectManager.TargetToolchain=MDK-ARM V4
RCC.48MHZClocksFreq_Value=75000000
RCC.AHBFreq_Value=16000000
RCC.APB1Freq_Value=16000000
RCC.APB2Freq_Value=16000000
RCC.CortexFreq_Value=16000000
RCC.HSE_VALUE=25000000
RCC.HSI_VALUE=16000000
RCC.LSE_VALUE=32768
RCC.PLLSourceVirtual=RCC_PLLSOURCE_HSE
RCC.SYSCLKFreq_VALUE=16000000
RCC.VCOOutputFreq_Value=300000000
VP_FREERTOS_VS_CMSIS_V2.Mode=CMSIS_V2
VP_SYS_VS_tim4.Mode=TIM4
board=custom

// file: Core/Src/main.c
/* USER CODE BEGIN Header */
/**
  ******************************************************************************
  * @file           : main.c
  * @brief          : Main program body
  ******************************************************************************
  * @attention
  *
  * <h2><center>&copy; Copyright (c) 2024 STMicroelectronics.
  * All rights reserved.</center></h2>
  *
  * This software component is licensed by ST under Ultimate Liberty license
  * SLA0044, the "License"; You may not use this file except in compliance with
  * the License. You may obtain a copy of the License at:
  *                             www.st.com/SLA0044
  *
  ******************************************************************************
  */
/* USER CODE END Header */
#include "main.h"
#include "cmsis_os.h"
#include "gpio.h"

void SystemClock_Config(void);
void MX_FREERTOS_Init(void);

int main(void)
{

  /* MCU Configuration--------------------------------------------------------*/

  /* Reset of all peripherals, Initializes the Flash interface and the Systick. */
  HAL_Init();

  /* Configure the system clock */
  SystemClock_Config();

  /* Initialize all configured peripherals */
  MX_GPIO_Init();

  /* Init scheduler */
  osKernelInitialize();  /* Call init function for freertos objects (in freertos.c) */
  MX_FREERTOS_Init();
  /* Start scheduler */
  osKernelStart();

  /* We should never get here as control is now taken by the scheduler */
  /* Infinite loop */
  while (1)
  {

  }
}

void SystemClock_Config(void)
{
  RCC_OscInitTypeDef RCC_OscInitStruct = {0};
  RCC_ClkInitTypeDef RCC_ClkInitStruct = {0};

  /** Configure the main internal regulator output voltage
  */
  __HAL_RCC_PWR_CLK_ENABLE();
  __HAL_PWR_VOLTAGESCALING_CONFIG(PWR_REGULATOR_VOLTAGE_SCALE2);
  /** Initializes the RCC Oscillators according to the specified parameters
  * in the RCC_OscInitTypeDef structure.
  */
  RCC_OscInitStruct.OscillatorType = RCC_OSCILLATORTYPE_HSI;
  RCC_OscInitStruct.HSIState = RCC_HSI_ON;
  RCC_OscInitStruct.HSICalibrationValue = RCC_HSICALIBRATION_DEFAULT;
  RCC_OscInitStruct.PLL.PLLState = RCC_PLL_NONE;
  if (HAL_RCC_OscConfig(&RCC_OscInitStruct) != HAL_OK)
  {
    Error_Handler();
  }
  /** Initializes the CPU, AHB and APB buses clocks
  */
  RCC_ClkInitStruct.ClockType = RCC_CLOCKTYPE_HCLK|RCC_CLOCKTYPE_SYSCLK
                              |RCC_CLOCKTYPE_PCLK1|RCC_CLOCKTYPE_PCLK2;
  RCC_ClkInitStruct.SYSCLKSource = RCC_SYSCLKSOURCE_HSI;
  RCC_ClkInitStruct.AHBCLKDivider = RCC_SYSCLK_DIV1;
  RCC_ClkInitStruct.APB1CLKDivider = RCC_HCLK_DIV1;
  RCC_ClkInitStruct.APB2CLKDivider = RCC_HCLK_DIV1;

  if (HAL_RCC_ClockConfig(&RCC_ClkInitStruct, FLASH_LATENCY_0) != HAL_OK)
  {
    Error_Handler();
  }
}

void HAL_TIM_PeriodElapsedCallback(TIM_HandleTypeDef *htim)
{
  if (htim->Instance == TIM4) {
    HAL_IncTick();
  }
}

void Error_Handler(void)
{
  __disable_irq();
  while (1)
  {
  }
}

/************************ (C) COPYRIGHT STMicroelectronics *****END OF FILE****/

// file: Core/Src/freertos.c
/* USER CODE BEGIN Header */
/**
  ******************************************************************************
  * File Name          : freertos.c
  * Description        : Code for freertos applications
  ******************************************************************************
  * @attention
  *
  * <h2><center>&copy; Copyright (c) 2024 STMicroelectronics.
  * All rights reserved.</center></h2>
  *
  * This software component is licensed by ST under Ultimate Liberty license
  * SLA0044, the "License"; You may not use this file except in compliance with
  * the License. You may obtain a copy of the License at:
  *                             www.st.com/SLA0044
  *
  ******************************************************************************
  */
/* USER CODE END Header */

#include "FreeRTOS.h"
#include "task.h"
#include "main.h"
#include "cmsis_os.h"

/* USER CODE BEGIN Includes */
#include "timers.h"
/* USER CODE END Includes */

/* USER CODE BEGIN Variables */
osTimerId_t Timer_ThreeHandle, Timer_FourHandle, Timer_FiveHandle, Timer_SixHandle;
/* USER CODE END Variables */
/* Definitions for Task_One */
osThreadId_t Task_OneHandle;
const osThreadAttr_t Task_One_attributes = {
  .name = "Task_One",
  .stack_size = 128 * 4,
  .priority = (osPriority_t) osPriorityNormal,
};
/* Definitions for Timer_One */
osTimerId_t Timer_OneHandle;
const osTimerAttr_t Timer_One_attributes = {
  .name = "Timer_One"
};
/* Definitions for Timer_Two */
osTimerId_t Timer_TwoHandle;
const osTimerAttr_t Timer_Two_attributes = {
  .name = "Timer_Two"
};

void TaskOne(void *argument);
void MyTimerOne_Callback(void *argument);
void MyTimerTwo_Callback(void *argument);

/* FreeRTOS API*/
void MyTimer_Callback(TimerHandle_t xTimer);

void MX_FREERTOS_Init(void); /* (MISRA C 2004 rule 8.1) */

void MX_FREERTOS_Init(void) {

  /* Create the timer(s) (CMSIS) */
  /* creation of Timer_One */
  Timer_OneHandle = osTimerNew(MyTimerOne_Callback, osTimerPeriodic, NULL, &Timer_One_attributes);

  /* creation of Timer_Two */
  Timer_TwoHandle = osTimerNew(MyTimerTwo_Callback, osTimerOnce, NULL, &Timer_Two_attributes);

 /* Create the timer(s) (FreeRTOS APIs) */
  Timer_ThreeHandle = xTimerCreate("Timer3",pdMS_TO_TICKS(100),pdTRUE,( void * ) 3,MyTimer_Callback);
  Timer_FourHandle = xTimerCreate("Timer4",pdMS_TO_TICKS(200),pdTRUE,( void * ) 4,MyTimer_Callback);
  Timer_FiveHandle = xTimerCreate("Timer5",pdMS_TO_TICKS(300),pdTRUE,( void * ) 5,MyTimer_Callback);
  Timer_SixHandle = xTimerCreate("Timer6",pdMS_TO_TICKS(400),pdTRUE,( void * ) 6,MyTimer_Callback);

  /* Create the thread(s) */
  /* creation of Task_One */
  Task_OneHandle = osThreadNew(TaskOne, NULL, &Task_One_attributes);

}

void TaskOne(void *argument)
{
  /* USER CODE BEGIN TaskOne */
	BaseType_t TimerStartRetVal = 0;

	// Start Timers Using CMSIS
	osTimerStart(Timer_OneHandle,100);
	osTimerStart(Timer_TwoHandle,1000);

	// Start Timers Using FreeRTOS APIs
	TimerStartRetVal = xTimerStart(Timer_ThreeHandle, 0);
	TimerStartRetVal = xTimerStart(Timer_FourHandle, 0);
	TimerStartRetVal = xTimerStart(Timer_FiveHandle, 0);
	TimerStartRetVal = xTimerStart(Timer_SixHandle, 0);

  /* Infinite loop */
  for(;;)
  {
    osDelay(1);
  }
  /* USER CODE END TaskOne */
}

/* MyTimerOne_Callback function */
unsigned short MyTimerOne_CallbackVar = 0;
void MyTimerOne_Callback(void *argument)
{
  /* USER CODE BEGIN MyTimerOne_Callback */
   MyTimerOne_CallbackVar ^= (1<<0);
  /* USER CODE END MyTimerOne_Callback */
}

/* MyTimerTwo_Callback function */
unsigned short MyTimerTwo_CallbackVar = 0;
void MyTimerTwo_Callback(void *argument)
{
  /* USER CODE BEGIN MyTimerTwo_Callback */
   MyTimerTwo_CallbackVar ^= (1<<0);
  /* USER CODE END MyTimerTwo_Callback */
}

/* USER CODE BEGIN Application */
/* FreeRTOS API */
void MyTimer_Callback(TimerHandle_t xTimer){
	uint32_t ulCount = 0;
	/* The number of times this timer has expired is saved as the
       timer's ID. Obtain the count. */
    ulCount = ( uint32_t ) pvTimerGetTimerID( xTimer );

	if(ulCount == 3){
		HAL_GPIO_TogglePin(GPIOB, GPIO_PIN_0);
	}
	else if(ulCount == 4){
		HAL_GPIO_TogglePin(GPIOB, GPIO_PIN_1);
	}
	else if(ulCount == 5){
		HAL_GPIO_TogglePin(GPIOB, GPIO_PIN_2);
	}
	else if(ulCount == 6){
		HAL_GPIO_TogglePin(GPIOB, GPIO_PIN_3);
	}
}
/* USER CODE END Application */

/************************ (C) COPYRIGHT STMicroelectronics *****END OF FILE****/
